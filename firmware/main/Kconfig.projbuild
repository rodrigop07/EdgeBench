## firmware/main/Kconfig.projbuild
```kconfig
menu "EdgeBench Configuration"

    config BENCH_ID
        int "Identificador da Bancada (Bench ID, 0 = Nao configurado)"
        default 0
        range 0 65535
        help
            Identificador numerico univoco desta bancada no chao de fabrica (1 a 65535).
            O valor 0 identifica que a bancada ainda nao foi configurada.

    config BROKER_URL
        string "Broker URL"
        default "mqtt://mqtt.eclipseprojects.io"
        help
            URL of the broker to connect to

    config BROKER_URL_FROM_STDIN
        bool
        default y if BROKER_URL = "FROM_STDIN"

endmenu
```

## firmware_central/sdkconfig.defaults
```kconfig
CONFIG_IDF_TARGET="esp32s3"
CONFIG_ESPTOOLPY_FLASHSIZE_4MB=y
CONFIG_ESPTOOLPY_FLASHSIZE="4MB"
```
